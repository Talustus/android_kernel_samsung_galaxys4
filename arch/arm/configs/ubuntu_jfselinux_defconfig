## arch/arm/configs/ubuntu_jfselinux_defconfig
```kconfig
CONFIG_AUDIT=y
CONFIG_AUDITSYSCALL=y
CONFIG_AUDIT_WATCH=y
CONFIG_AUDIT_TREE=y
CONFIG_SECURITY=y
CONFIG_SECURITY_NETWORK=y
CONFIG_SECURITYFS=y
CONFIG_SECURITY_PATH=y
CONFIG_LSM_MMAP_MIN_ADDR=4096
CONFIG_SECURITY_SELINUX=y
# CONFIG_DEFAULT_SECURITY_SELINUX is not set
CONFIG_SECURITY_SELINUX_DISABLE=y
CONFIG_SECURITY_SELINUX_DEVELOP=y
CONFIG_SECURITY_SELINUX_AVC_STATS=y
CONFIG_SECURITY_SELINUX_CHECKREQPROT_VALUE=1
CONFIG_SECURITY_SELINUX_BOOTPARAM=y
CONFIG_SECURITY_SELINUX_BOOTPARAM_VALUE=0
# CONFIG_SECURITY_SELINUX_POLICYDB_VERSION_MAX is not set

CONFIG_SECURITY_APPARMOR=y
CONFIG_DEFAULT_SECURITY_APPARMOR=y
CONFIG_DEFAULT_SECURITY="apparmor"
CONFIG_SECURITY_APPARMOR_HASH=y
# CONFIG_SECURITY_APPARMOR_STATS is not set
CONFIG_SECURITY_APPARMOR_UNCONFINED_INIT=y
CONFIG_SECURITY_APPARMOR_BOOTPARAM_VALUE=1

CONFIG_SECURITY_SMACK=y
# CONFIG_DEFAULT_SECURITY_SMACK is not set

CONFIG_SECURITY_TOMOYO=y
# CONFIG_DEFAULT_SECURITY_TOMOYO is not set
CONFIG_SECURITY_TOMOYO_MAX_ACCEPT_ENTRY=2048
CONFIG_SECURITY_TOMOYO_MAX_AUDIT_LOG=1024
# CONFIG_SECURITY_TOMOYO_OMIT_USERSPACE_LOADER is not set
CONFIG_SECURITY_TOMOYO_POLICY_LOADER="/sbin/tomoyo-init"
CONFIG_SECURITY_TOMOYO_ACTIVATION_TRIGGER="/sbin/init"

CONFIG_SECURITY_YAMA=y
# CONFIG_DEFAULT_SECURITY_YAMA is not set
CONFIG_SECURITY_YAMA_STACKED=y
```

## fs/exfat/Kconfig
```kconfig
config EXFAT_FS
	tristate "EXFAT file system support"
	help
	  EXFAT is a propritary file system of Microsoft Windows XP, 2003, Vista, Seven... .

	  Saying Y or M here enables EXFAT support.
	  This Kernel module is a leaked one and possibly not licensed under GPL...
	  Use with care ...
```
